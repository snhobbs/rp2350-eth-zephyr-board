## Kconfig.rp2350_eth
```kconfig
# Copyright (c) 2025 Stephano Cetola
# SPDX-License-Identifier: Apache-2.0

config BOARD_RP2350_ETH
	select SOC_RP2350A_HAZARD3 if BOARD_RP2350_ETH_RP2350A_HAZARD3
	select SOC_RP2350A_M33 if BOARD_RP2350_ETH_RP2350A_M33
```

## board.yml
```yaml
board:
  name: rp2350_eth
  full_name: RP2350 Eth
  vendor: waveshare
  socs:
    - name: rp2350a
      variants:
        - name: w
          cpucluster: m33
          variants:
            - name: mcuboot
              cpucluster: m33
        - name: mcuboot
          cpucluster: m33
```
